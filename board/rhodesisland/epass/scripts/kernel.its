## board/rhodesisland/epass/scripts/kernel.its
```
/dts-v1/;
/ {
    description = "ePass kernel boot bundle";
    #address-cells = <1>;
    images {
        kernel {
            description = "Linux zImage";
            data = /incbin/("./zImage");
            type = "kernel";
            arch = "arm";
            os = "linux";
            compression = "none";
            load = <0x80008000>;
            entry = <0x80008000>;
        };
    };
};
```

## package/battery_hwcd/Config.in
```kconfig
config BR2_PACKAGE_BATTERY_HWCD
	bool "battery_hwcd"
	help
	  Userspace battery indicator daemon for the epass DEBE hardware
	  cursor overlay.  Reads /sys/class/power_supply and drives the
	  /sys/kernel/battery_hwc/ overlay (independent of the DRM master):
	  hidden above 10% until a key is pressed, red 1Hz blink below 10%,
	  a charging bolt while plugged in.

	  Requires the sun4i backend HWC overlay kernel patch.
```

## package/drmtest/Config.in
```kconfig
config BR2_PACKAGE_DRMTEST
	bool "drmtest"
	depends on BR2_TOOLCHAIN_HAS_THREADS # libdrm
	select BR2_PACKAGE_LIBDRM
	help
	  DRM/KMS screen pattern tester (fbtest equivalent for
	  modern DRM). Draws SMPTE bars, gradients, grids and
	  solid colors via legacy KMS + dumb buffers.

comment "drmtest needs a toolchain w/ threads"
	depends on !BR2_TOOLCHAIN_HAS_THREADS
```

## package/epass-test/Config.in
```kconfig
config BR2_PACKAGE_EPASS_TEST
	bool "epass-test"
	depends on BR2_TOOLCHAIN_HAS_THREADS # libdrm
	select BR2_PACKAGE_LIBDRM
	help
	  epass hardware test tools:
	  - drmtest: DRM/KMS screen pattern tester (fbtest
	    equivalent). Draws SMPTE bars, gradients, grids and
	    solid colors via legacy KMS + dumb buffers.
	  - c8test: DEBE layer palette (C8/index) mode tester.
	    Needs kernel patch 0029 (DRM_FORMAT_C8 +
	    /sys/kernel/debe_palette/palette).

comment "epass-test needs a toolchain w/ threads"
	depends on !BR2_TOOLCHAIN_HAS_THREADS
```

## package/epass_usb_responder/Config.in
```kconfig
config BR2_PACKAGE_EPASS_USB_RESPONDER
	bool "epass_usb_responder"
	help
	  Electronic Pass USB Responder.

	  https://github.com/rhodesepass/epass_usb_responder
```

## package/epassctl/Config.in
```kconfig
config BR2_PACKAGE_EPASSCTL
	bool "epassctl"
	help
	  Electronic Pass cli for epass_drm_app.

	  https://github.com/rhodesepass/epassctl
```

## package/libcedarx/Config.in
```kconfig
config BR2_PACKAGE_LIBCEDARX
	depends on BR2_PACKAGE_LIBCEDARC
	bool "libcedarx"
	help
		Allwinner CedarX is a middware to process multimedia content.

config BR2_PACKAGE_LIBCEDARX_ARCHLIB
	string "CedarX Arch library select"
	default "openwrt-arm926-glibc"
	help
		see libcedarx/external


comment "libcedarx needs libcedarc"
	depends on !BR2_PACKAGE_LIBCEDARC
```
