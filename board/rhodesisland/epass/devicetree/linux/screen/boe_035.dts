#include <dt-bindings/display/st7701initseq.h>

/dts-v1/;
/plugin/;
/ {
    fragment@1 {
        target = <&st7701initseq>;
        __overlay__ {
            status = "okay";
            /* pclk_khz hact hfp hslen hbp vact vfp vslen vbp (panel-simple sargon_papyrus_mode) */
            srgn,panel-timing = <64000 720 45 4 45 1280 30 8 20>;
            init-sequence = <
                    ST7701INIT_BEGIN_WRITE

                    ST7701INIT_WRITE_COMMAND_8 0xB9
                    ST7701INIT_WRITE_BYTES 3 0xF1 0x12 0x83

                    ST7701INIT_WRITE_COMMAND_8 0xB1
                    ST7701INIT_WRITE_BYTES 5
                    0x00 0x00 0x00 0xDA 0x80

                    ST7701INIT_WRITE_COMMAND_8 0xB2
                    ST7701INIT_WRITE_BYTES 3 0xC8 0x12 0xF0
                    
                    ST7701INIT_WRITE_COMMAND_8 0xB3
                    ST7701INIT_WRITE_BYTES 10
                    0x10 0x10 0x28 0x28
                    0x03 0xFF 0x00 0x00
                    0x00 0x00

                    ST7701INIT_WRITE_C8_D8 0xB4 0x80

                    ST7701INIT_WRITE_COMMAND_8 0xB5
                    ST7701INIT_WRITE_BYTES 2 0x0A 0x0A

                    ST7701INIT_WRITE_COMMAND_8 0xB6
                    ST7701INIT_WRITE_BYTES 2 0x4B 0x4B

                    ST7701INIT_WRITE_COMMAND_8 0xB8
                    ST7701INIT_WRITE_BYTES 4 0x26 0x22 0xF0 0x63
                    
                    ST7701INIT_WRITE_COMMAND_8 0xBA
                    ST7701INIT_WRITE_BYTES 27
                    0x32 0x81 0x05 0xf9
                    0x0e 0x0e 0x20 0x00
                    0x00 0x00 0x00 0x00
                    0x00 0x00 0x44 0x25
                    0x00 0x90 0x0a 0x00
                    0x00 0x01 0x4f 0x01
                    0x00 0x00 0x37

                    ST7701INIT_WRITE_C8_D8 0xBC 0x47

                    ST7701INIT_WRITE_COMMAND_8 0xBF
                    ST7701INIT_WRITE_BYTES 3 0x02 0x11 0x00

                    ST7701INIT_WRITE_COMMAND_8 0xC0
                    ST7701INIT_WRITE_BYTES 9
                    0x73 0x73 0x50 0x50
                    0x00 0x00 0x12 0x70
                    0x00

                    ST7701INIT_WRITE_COMMAND_8 0xC1
                    ST7701INIT_WRITE_BYTES 12
                    0x53 0x00 0x32 0x32
                    0x77 0xf4 0xff 0xff
                    0xcc 0xcc 0x77 0x77

                    ST7701INIT_WRITE_COMMAND_8 0xC6
                    ST7701INIT_WRITE_BYTES 6
                    0x82 0x00 0xbf 0xff 0x00 0xff

                    ST7701INIT_WRITE_COMMAND_8 0xC7
                    ST7701INIT_WRITE_BYTES 6
                    0xb8 0x00 0x0a 0x00 0x00 0x00

                    ST7701INIT_WRITE_COMMAND_8 0xC8
                    ST7701INIT_WRITE_BYTES 4
                    0x10 0x40 0x1e 0x02

                    ST7701INIT_WRITE_C8_D8 0xCC 0x0b

                    ST7701INIT_WRITE_COMMAND_8 0xE0
                    ST7701INIT_WRITE_BYTES 34
                    0x00 0x0b 0x12 0x25
                    0x30 0x39 0x42 0x37
                    0x07 0x0d 0x0d 0x11
                    0x13 0x10 0x12 0x12
                    0x19 0x00 0x0b 0x12
                    0x25 0x30 0x39 0x42
                    0x37 0x07 0x0d 0x0d
                    0x11 0x13 0x10 0x12
                    0x12 0x19

                    ST7701INIT_WRITE_COMMAND_8 0xE3
                    ST7701INIT_WRITE_BYTES 14
                    0x07 0x07 0x0b 0x0b
                    0x0b 0x0b 0x00 0x00
                    0x00 0x00 0xff 0x00
                    0xc0 0x10

                    ST7701INIT_WRITE_COMMAND_8 0xE9
                    ST7701INIT_WRITE_BYTES 63
                    0xC8 0x10 0x10 0x05
                    0x0F 0x80 0x81 0x12
                    0x31 0x23 0xAF 0x8d
                    0x80 0x81 0x7F 0x10
                    0x03 0x00 0x19 0x00
                    0x00 0x00 0x03 0x00
                    0x19 0x00 0x00 0x00
                    0x4F 0x8A 0xCA 0xB7
                    0x58 0x31 0x75 0x31
                    0x31 0x88 0x88 0x4F
                    0x89 0xBA 0xB6 0x48
                    0x20 0x64 0x20 0x20
                    0x88 0x88 0x00 0x00
                    0x00 0x00 0x00 0x80
                    0x81 0x00 0x00 0x00
                    0x00 0x00 0x00

                    ST7701INIT_WRITE_COMMAND_8 0xEA
                    ST7701INIT_WRITE_BYTES 61
                    0x96 0x1F 0x01 0x01
                    0x00 0x00 0x03 0x1C
                    0x43 0x03 0x03 0x00
                    0x48 0xF2 0x0A 0xB0
                    0x28 0x46 0x02 0x46
                    0x9B 0x88 0x88 0x48
                    0xF3 0x1A 0xB1 0x38
                    0x57 0x13 0x57 0xAC
                    0x88 0x88 0x23 0x10
                    0x00 0x00 0x74 0x00
                    0x00 0x00 0x00 0x00
                    0x00 0x0D 0x80 0x00
                    0xF0 0x00 0x05 0x04
                    0x12 0x30 0x70 0x80
                    0x81 0x70 0x80 0x81
                    0x00

                    ST7701INIT_WRITE_COMMAND_8 0xEF
                    ST7701INIT_WRITE_BYTES 3 0xff 0xff 0x01

                    ST7701INIT_WRITE_COMMAND_8 0x11
                    ST7701INIT_END_WRITE

                    ST7701INIT_DELAY 120

                    ST7701INIT_BEGIN_WRITE

                    ST7701INIT_WRITE_COMMAND_8 0x29
                    ST7701INIT_END_WRITE

                    ST7701INIT_DELAY 20
            >;
        };
    };

    fragment@2 {
        target = <&panel>;
        __overlay__ {
            compatible = "sargon,papyrus", "simple-panel";
        };
    };

    fragment@3 {
        target = <&tcon0>;
        __overlay__ {
            srgn,has-de;
        };
    };
};