#include <dt-bindings/display/st7701initseq.h>

/dts-v1/;
/plugin/;
/ {
    fragment@1 {
        target = <&st7701initseq>;
        __overlay__ {
            status = "okay";
            init-sequence = <
                ST7701INIT_BEGIN_WRITE

                ST7701INIT_WRITE_C8_D8 0xFF 0x30
                ST7701INIT_WRITE_C8_D8 0xFF 0x52
                ST7701INIT_WRITE_C8_D8 0xFF 0x01
                ST7701INIT_WRITE_C8_D8 0xE3 0x00
                ST7701INIT_WRITE_C8_D8 0xF6 0xC0
                ST7701INIT_WRITE_C8_D8 0xF0 0x00
                ST7701INIT_WRITE_C8_D8 0x0A 0x00
                ST7701INIT_WRITE_C8_D8 0x23 0x92   /* vendor 0xA2=DE 模式 -> 0x92=SYNC/HV 模式 */
                ST7701INIT_WRITE_C8_D8 0x24 0x10
                ST7701INIT_WRITE_C8_D8 0x25 0x0A
                ST7701INIT_WRITE_C8_D8 0x26 0x2E
                ST7701INIT_WRITE_C8_D8 0x27 0x2E
                ST7701INIT_WRITE_C8_D8 0x29 0x04
                ST7701INIT_WRITE_C8_D8 0x2A 0xFF
                ST7701INIT_WRITE_C8_D8 0x38 0x9C
                ST7701INIT_WRITE_C8_D8 0x39 0xA7
                ST7701INIT_WRITE_C8_D8 0x3A 0x5E   /* VCOM */
                ST7701INIT_WRITE_C8_D8 0x49 0x3C
                ST7701INIT_WRITE_C8_D8 0x91 0x67
                ST7701INIT_WRITE_C8_D8 0x92 0x67
                ST7701INIT_WRITE_C8_D8 0xA0 0x55
                ST7701INIT_WRITE_C8_D8 0xA1 0x50
                ST7701INIT_WRITE_C8_D8 0xA4 0x9C
                ST7701INIT_WRITE_C8_D8 0xA7 0x02
                ST7701INIT_WRITE_C8_D8 0xA8 0x01
                ST7701INIT_WRITE_C8_D8 0xA9 0x01
                ST7701INIT_WRITE_C8_D8 0xAA 0xFC
                ST7701INIT_WRITE_C8_D8 0xAB 0x28
                ST7701INIT_WRITE_C8_D8 0xAC 0x06
                ST7701INIT_WRITE_C8_D8 0xAD 0x06
                ST7701INIT_WRITE_C8_D8 0xAE 0x06
                ST7701INIT_WRITE_C8_D8 0xAF 0x03
                ST7701INIT_WRITE_C8_D8 0xB0 0x08
                ST7701INIT_WRITE_C8_D8 0xB1 0x26
                ST7701INIT_WRITE_C8_D8 0xB2 0x28
                ST7701INIT_WRITE_C8_D8 0xB3 0x28
                ST7701INIT_WRITE_C8_D8 0xB4 0x03
                ST7701INIT_WRITE_C8_D8 0xB5 0x08
                ST7701INIT_WRITE_C8_D8 0xB6 0x26
                ST7701INIT_WRITE_C8_D8 0xB7 0x08
                ST7701INIT_WRITE_C8_D8 0xB8 0x26

                ST7701INIT_WRITE_C8_D8 0xFF 0x30
                ST7701INIT_WRITE_C8_D8 0xFF 0x52
                ST7701INIT_WRITE_C8_D8 0xFF 0x02
                ST7701INIT_WRITE_C8_D8 0xB1 0x11
                ST7701INIT_WRITE_C8_D8 0xD1 0x15
                ST7701INIT_WRITE_C8_D8 0xB4 0x2F
                ST7701INIT_WRITE_C8_D8 0xD4 0x31
                ST7701INIT_WRITE_C8_D8 0xB2 0x13
                ST7701INIT_WRITE_C8_D8 0xD2 0x15
                ST7701INIT_WRITE_C8_D8 0xB3 0x2D
                ST7701INIT_WRITE_C8_D8 0xD3 0x33
                ST7701INIT_WRITE_C8_D8 0xB6 0x22
                ST7701INIT_WRITE_C8_D8 0xD6 0x24
                ST7701INIT_WRITE_C8_D8 0xB7 0x3D
                ST7701INIT_WRITE_C8_D8 0xD7 0x41
                ST7701INIT_WRITE_C8_D8 0xC1 0x08
                ST7701INIT_WRITE_C8_D8 0xE1 0x08
                ST7701INIT_WRITE_C8_D8 0xB8 0x0D
                ST7701INIT_WRITE_C8_D8 0xD8 0x0D
                ST7701INIT_WRITE_C8_D8 0xB9 0x04
                ST7701INIT_WRITE_C8_D8 0xD9 0x04
                ST7701INIT_WRITE_C8_D8 0xBD 0x15
                ST7701INIT_WRITE_C8_D8 0xDD 0x15
                ST7701INIT_WRITE_C8_D8 0xBC 0x13
                ST7701INIT_WRITE_C8_D8 0xDC 0x13
                ST7701INIT_WRITE_C8_D8 0xBB 0x11
                ST7701INIT_WRITE_C8_D8 0xDB 0x11
                ST7701INIT_WRITE_C8_D8 0xBA 0x11
                ST7701INIT_WRITE_C8_D8 0xDA 0x11
                ST7701INIT_WRITE_C8_D8 0xBE 0x17
                ST7701INIT_WRITE_C8_D8 0xDE 0x19
                ST7701INIT_WRITE_C8_D8 0xBF 0x0F
                ST7701INIT_WRITE_C8_D8 0xDF 0x11
                ST7701INIT_WRITE_C8_D8 0xC0 0x16
                ST7701INIT_WRITE_C8_D8 0xE0 0x18
                ST7701INIT_WRITE_C8_D8 0xB5 0x37
                ST7701INIT_WRITE_C8_D8 0xD5 0x34
                ST7701INIT_WRITE_C8_D8 0xB0 0x02
                ST7701INIT_WRITE_C8_D8 0xD0 0x05

                ST7701INIT_WRITE_C8_D8 0xFF 0x30
                ST7701INIT_WRITE_C8_D8 0xFF 0x52
                ST7701INIT_WRITE_C8_D8 0xFF 0x03
                ST7701INIT_WRITE_C8_D8 0x05 0x00
                ST7701INIT_WRITE_C8_D8 0x06 0x00
                ST7701INIT_WRITE_C8_D8 0x08 0x06
                ST7701INIT_WRITE_C8_D8 0x09 0x07
                ST7701INIT_WRITE_C8_D8 0x25 0x32
                ST7701INIT_WRITE_C8_D8 0x2A 0x0A
                ST7701INIT_WRITE_C8_D8 0x2B 0x0B
                ST7701INIT_WRITE_C8_D8 0x70 0x0F
                ST7701INIT_WRITE_C8_D8 0x71 0xC0
                ST7701INIT_WRITE_C8_D8 0x30 0x2A
                ST7701INIT_WRITE_C8_D8 0x31 0x2A
                ST7701INIT_WRITE_C8_D8 0x32 0x2A
                ST7701INIT_WRITE_C8_D8 0x33 0x2A
                ST7701INIT_WRITE_C8_D8 0x34 0xB1
                ST7701INIT_WRITE_C8_D8 0x35 0x76
                ST7701INIT_WRITE_C8_D8 0x36 0x08
                ST7701INIT_WRITE_C8_D8 0x40 0x07
                ST7701INIT_WRITE_C8_D8 0x41 0x08
                ST7701INIT_WRITE_C8_D8 0x42 0x09
                ST7701INIT_WRITE_C8_D8 0x43 0x0A
                ST7701INIT_WRITE_C8_D8 0x45 0x04
                ST7701INIT_WRITE_C8_D8 0x46 0x05
                ST7701INIT_WRITE_C8_D8 0x48 0x06
                ST7701INIT_WRITE_C8_D8 0x49 0x07
                ST7701INIT_WRITE_C8_D8 0x50 0x0B
                ST7701INIT_WRITE_C8_D8 0x51 0x0C
                ST7701INIT_WRITE_C8_D8 0x52 0x0D
                ST7701INIT_WRITE_C8_D8 0x53 0x0E
                ST7701INIT_WRITE_C8_D8 0x55 0x08
                ST7701INIT_WRITE_C8_D8 0x56 0x09
                ST7701INIT_WRITE_C8_D8 0x58 0x0A
                ST7701INIT_WRITE_C8_D8 0x59 0x0B
                ST7701INIT_WRITE_C8_D8 0x80 0x1F
                ST7701INIT_WRITE_C8_D8 0x81 0x00
                ST7701INIT_WRITE_C8_D8 0x82 0x16
                ST7701INIT_WRITE_C8_D8 0x83 0x15
                ST7701INIT_WRITE_C8_D8 0x84 0x0A
                ST7701INIT_WRITE_C8_D8 0x85 0x0C
                ST7701INIT_WRITE_C8_D8 0x86 0x0E
                ST7701INIT_WRITE_C8_D8 0x87 0x10
                ST7701INIT_WRITE_C8_D8 0x88 0x02
                ST7701INIT_WRITE_C8_D8 0x8F 0x06
                ST7701INIT_WRITE_C8_D8 0x96 0x1F
                ST7701INIT_WRITE_C8_D8 0x97 0x00
                ST7701INIT_WRITE_C8_D8 0x98 0x18
                ST7701INIT_WRITE_C8_D8 0x99 0x17
                ST7701INIT_WRITE_C8_D8 0x9A 0x09
                ST7701INIT_WRITE_C8_D8 0x9B 0x0B
                ST7701INIT_WRITE_C8_D8 0x9C 0x0D
                ST7701INIT_WRITE_C8_D8 0x9D 0x0F
                ST7701INIT_WRITE_C8_D8 0x9E 0x01
                ST7701INIT_WRITE_C8_D8 0xA5 0x05
                ST7701INIT_WRITE_C8_D8 0xB0 0x00
                ST7701INIT_WRITE_C8_D8 0xB1 0x1F
                ST7701INIT_WRITE_C8_D8 0xB2 0x16
                ST7701INIT_WRITE_C8_D8 0xB3 0x15
                ST7701INIT_WRITE_C8_D8 0xB4 0x0F
                ST7701INIT_WRITE_C8_D8 0xB5 0x0D
                ST7701INIT_WRITE_C8_D8 0xB6 0x0B
                ST7701INIT_WRITE_C8_D8 0xB7 0x09
                ST7701INIT_WRITE_C8_D8 0xB8 0x05
                ST7701INIT_WRITE_C8_D8 0xBF 0x01
                ST7701INIT_WRITE_C8_D8 0xC6 0x00
                ST7701INIT_WRITE_C8_D8 0xC7 0x1F
                ST7701INIT_WRITE_C8_D8 0xC8 0x18
                ST7701INIT_WRITE_C8_D8 0xC9 0x17
                ST7701INIT_WRITE_C8_D8 0xCA 0x10
                ST7701INIT_WRITE_C8_D8 0xCB 0x0E
                ST7701INIT_WRITE_C8_D8 0xCC 0x0C
                ST7701INIT_WRITE_C8_D8 0xCD 0x0A
                ST7701INIT_WRITE_C8_D8 0xCE 0x06
                ST7701INIT_WRITE_C8_D8 0xD5 0x02

                ST7701INIT_WRITE_C8_D8 0xFF 0x30
                ST7701INIT_WRITE_C8_D8 0xFF 0x52
                ST7701INIT_WRITE_C8_D8 0xFF 0x00
                /* ST7701INIT_WRITE_C8_D8 0x3A 0x50   补: 16-bit RGB565 (vendor 缺, 默认 24-bit) */
                ST7701INIT_WRITE_C8_D8 0x36 0x0A
                ST7701INIT_WRITE_COMMAND_8 0x11    /* sleep out */
                ST7701INIT_END_WRITE

                ST7701INIT_DELAY 200

                ST7701INIT_BEGIN_WRITE
                ST7701INIT_WRITE_COMMAND_8 0x29    /* display on */
                ST7701INIT_END_WRITE

                ST7701INIT_DELAY 100
            >;
        };
    };

    fragment@2 {
        target = <&panel>;
        __overlay__ {
            compatible = "lattland,hsd-nv3052", "simple-panel";
        };
    };

    fragment@3 {
        target = <&tcon0>;
        __overlay__ {
            srgn,swap-b-r;
        };
    };
};
