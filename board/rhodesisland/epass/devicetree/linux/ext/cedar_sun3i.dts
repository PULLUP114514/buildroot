/dts-v1/;
/plugin/;
/ {
    fragment@1 {
        target = <&cedar_ve>;
        __overlay__ {
            compatible = "allwinner,suniv-f1c200s-cedar-sun3i";
            status = "okay";
        };
    };
};
